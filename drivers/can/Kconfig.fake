## drivers/can/Kconfig.fake
```kconfig
# Fake CAN configuration options

# Copyright (c) 2022 Vestas Wind Systems A/S
# SPDX-License-Identifier: Apache-2.0

config CAN_FAKE
	bool "Fake CAN driver"
	default y
	depends on DT_HAS_ZEPHYR_FAKE_CAN_ENABLED
	help
	  Enable support for the FFF-based fake CAN driver.

if CAN_FAKE
config CAN_FAKE_ENABLE_RX_MESSAGE_QUEUE_INJECTION
	bool "Allow injection of messages into RX queue"
	depends on CAN_FAKE
	default n
	help
	  Enabling this config allows for injection of messages
	  into the RX message queue using the
	  `inject_can_frame_to_recv_msgq` function.

config CAN_FAKE_DISABLE_FAKES_RESET
	bool "Disable resetting of fakes"
	depends on CAN_FAKE
	default n
	help
	  Typically the fakes are reset during tests. If the CAN fake driver
	  is used for testing a subsystem which uses a can driver, it would
	  be interesting to check if the relevant functions are called. This
	  flag would disable resetting the fake call counter.

endif # CAN_FAKE
```

## drivers/misc/trinamic/Kconfig
```kconfig
# Copyright (c) 2023 Carl Zeiss Meditec AG
# SPDX-License-Identifier: Apache-2.0

config TMC_SPI
	bool
	help
	    If y, the TMC module uses SPI

config TMC_UART
    bool
    help
        If y, the TMC module uses UART

config TRINAMIC
    bool
    help
        If y, the TRINAMIC module is used


if TRINAMIC
module = TRINAMIC
module-str = trinamic
source "subsys/logging/Kconfig.template.log_config"
endif

source "drivers/misc/trinamic/Kconfig.tmc5041"
```

## drivers/misc/trinamic/Kconfig.tmc5041
```kconfig
# Copyright (c) 2023 Carl Zeiss Meditec AG
# SPDX-License-Identifier: Apache-2.0

config TRINAMIC_TMC5041
	bool "TMC5041 dual controller/driver for up to two 2-phase bipolar stepper motors"
	default $(dt_compat_enabled,$(DT_COMPACT_TRINAMIC_TMC5041))
	depends on SPI
	select TMC_SPI
	select TRINAMIC
	help
	  Enable driver for TMC5041.

config TMC5041_INT
    bool "TMC5041 interrupt handling support via INT pin"
    depends on TRINAMIC_TMC5041
    help
        When enabled, the TMC5041 can be provided with a interrupt input GPIO to
        in order to react on a position reached event. In case more than one
        interrupt source is possible, it is necessary to carefully check for the
        actual event, without risking losing an event.

config TRINAMIC_TMC5041_SHELL
	bool "Trinamic TMC5041 shell"
	depends on TRINAMIC_TMC5041
	default y if !SHELL_MINIMAL
	help
	  This shell provides specialised access to basic trinamic tmc5041 shell to
	  read/write registers. Here, information about the TMC5041 registers are
	  accessible.
```

## drivers/motor/Kconfig
```kconfig
# SPDX-FileCopyrightText: Copyright (c) 2024 Carl Zeiss Meditec AG
# SPDX-License-Identifier: Apache-2.0

menuconfig MOTOR
	bool "Motor"
	help
		Enable Motor

if MOTOR

module = MOTOR
module-str = motor
source "subsys/logging/Kconfig.template.log_config"

config MOTOR_INIT_PRIORITY
	int "Motor init priority"
	default 90
	help
	  Motor initialization priority.

config MOTOR_SHELL
	bool "Shell for motor control"
	depends on SHELL
	default y if !SHELL_MINIMAL
	help
	  This shell provides specialised access to basic motor device shell
	  to execute various functions.

comment "Motor Drivers"

source "drivers/motor/gpio_stepper_motor_controller/Kconfig"
source "drivers/motor/tmc5041/Kconfig"

endif
```

## drivers/motor/gpio_stepper_motor_controller/Kconfig
```kconfig
# SPDX-FileCopyrightText: Copyright (c) 2023 Carl Zeiss Meditec AG
# SPDX-License-Identifier: Apache-2.0

menu "GPIO STEPPER MOTOR CONTROLLER Driver"

config GPIO_STEPPER_MOTOR_CONTROLLER
	bool "Activate driver for GPIO_STEPPER_MOTOR_CONTROLLER"
	help
	  GPIO_STEPPER_MOTOR_CONTROLLER driver for stepper motor control

endmenu
```

## drivers/motor/tmc5041/Kconfig
```kconfig
# SPDX-FileCopyrightText: Copyright (c) 2023 Carl Zeiss Meditec AG
# SPDX-License-Identifier: Apache-2.0

menu "TMC5041 Driver"

config TMC5041_SPI
	bool "Use TMC5041 with SPI"
	help
	  If y, the TMC5041 module uses SPI

config TMC5041
	bool "Activate driver for TMC5041"
	default $(dt_compat_enabled,$(DT_COMPACT_TRINAMIC_TMC5041))
	depends on SPI
	select TMC5041_SPI
	help
	  TMC5041 dual controller/driver for up to two 2-phase bipolar stepper motors.

config TMC5041_INT
	bool "TMC5041 interrupt handling support via INT pin"
	depends on TMC5041
	help
	  When enabled, the TMC5041 can be provided with a interrupt input GPIO to
	  in order to react on a position reached event. In case more than one
	  interrupt source is possible, it is necessary to carefully check for the
	  actual event, without risking losing an event.

config TMC5041_SHELL
	bool "TMC5041 shell"
	depends on TMC5041
	depends on SHELL
	default y if !SHELL_MINIMAL
	help
	  This shell provides specialised access to basic trinamic tmc5041 shell to
	  read/write registers. Here, information about the TMC5041 registers are
	  accessible.

endmenu
```

## drivers/sensor/ams/tcs3430/Kconfig
```kconfig
# Copyright 2023 Google LLC
# SPDX-FileCopyrightText: Copyright (c) 2025 Carl Zeiss Meditec AG
# SPDX-License-Identifier: Apache-2.0

config TCS3430
	bool "TCS3430 Sensor"
	default y
	depends on DT_HAS_AMS_TCS3430_ENABLED
	select I2C
	help
	  Enable driver for TCS3430 sensors.
```

## drivers/stepper/Kconfig.gpio
```kconfig
# SPDX-FileCopyrightText: Copyright (c) 2024 Carl Zeiss Meditec AG
# SPDX-License-Identifier: Apache-2.0

menu "GPIO STEPPER Driver"

config GPIO_STEPPER
	bool "Activate driver for GPIO_STEPPER_MOTOR_CONTROLLER"
	depends on DT_HAS_GPIO_STEPPER_ENABLED
	default y
	help
	  GPIO_STEPPER_MOTOR_CONTROLLER driver for stepper motor control

endmenu
```

## drivers/stepper_motor/Kconfig
```kconfig
# SPDX-FileCopyrightText: Copyright (c) 2023 Carl Zeiss Meditec AG
# SPDX-License-Identifier: Apache-2.0

menuconfig STEPPER_MOTOR
	bool "Stepper Motor"
	help
		Enable stepper motor

if STEPPER_MOTOR

module = STEPPER_MOTOR
module-str = stepper_motor
source "subsys/logging/Kconfig.template.log_config"

config STEPPER_MOTOR_INIT_PRIORITY
	int "Stepper Motor init priority"
	default 90
	help
	  Stepper motor initialization priority.

config STEPPER_MOTOR_SHELL
	bool "Shell for stepper motor control"
	depends on SHELL
	default y if !SHELL_MINIMAL
	help
	  This shell provides specialised access to basic stepper motor device shell
	  to execute various functions.

comment "Stepper Motor Drivers"

source "drivers/stepper_motor/gpio_stepper_motor_controller/Kconfig"
source "drivers/stepper_motor/tmc5041/Kconfig"

endif
```

## dts/bindings/can/can-fd-controller.yaml
```yaml
# Common fields for CAN FD controllers

include: can-controller.yaml

properties:
  bus-speed-data:
    type: int
    deprecated: true
    description: |
      Deprecated. This property has been renamed to bitrate-data.

      Initial data phase bitrate in bit/s.  If this is unset, the initial data phase bitrate is set
      to CONFIG_CAN_DEFAULT_BITRATE_DATA.
  sample-point-data:
    type: int
    description: |
      Initial data phase sample point in per mille (e.g. 875 equals 87.5%).
  tx-delay-comp-offset:
    type: int
    default: 0
  bitrate-data:
    type: int
    description: |
      Initial data phase bitrate in bit/s.  If this is unset, the initial data phase bitrate is set
      to CONFIG_CAN_DEFAULT_BITRATE_DATA.
```

## dts/bindings/misc/trinamic,tmc5041.yaml
```yaml
# Copyright (c) 2022 Nordic Semiconductor ASA
# SPDX-License-Identifier: Apache-2.0

description: TRINAMIC TMC5041

compatible: "trinamic,tmc5041"

include: spi-device.yaml

properties:
  int-gpios:
    type: phandle-array
    required: false
    description: |
      Identifies pin for the INT signal on the module. Tristate
      interrupt output based on ramp generator flags RAMP_STAT
      bits 4, 5, 6 & 7. Outputs positive active interrupt signal.

  pp-gpios:
    type: phandle-array
    required: false
    description: |
      Identifies pin for the PP signal on the module. Tristate
      position compare output for motor 1 (poscmp_enable=1).

  refr1-gpios:
    type: phandle-array
    required: false
    description: |
      Identifies pin for the REFR1 signal on the module. Right
      reference switch input for motor 1.

  refl1-gpios:
    type: phandle-array
    required: false
    description: |
      Identifies pin for the REFR1 signal on the module. Left
      reference switch input for motor 1.

  refr2-gpios:
    type: phandle-array
    required: false
    description: |
      Identifies pin for the REFR2 signal on the module. Right
      reference switch input for motor 2.

  refl2-gpios:
    type: phandle-array
    required: false
    description: |
      Identifies pin for the REFR2 signal on the module. Left
      reference switch input for motor 2.
```

## dts/bindings/sensor/adi,ltc2990.yaml
```yaml
# SPDX-FileCopyrightText: Copyright (c) 2023 Carl Zeiss Meditec AG
# SPDX-License-Identifier: Apache 2.0

description: ADLTC2990 Quad I2C Voltage, Current and Temperature Monitor

compatible: "adi,ltc2990"

include: [sensor-device.yaml,i2c-device.yaml]

properties:
  reg:
    required: true
```

## dts/bindings/sensor/ams,tcs3430.yaml
```yaml
# Copyright 2023 Google LLC
# SPDX-License-Identifier: Apache-2.0

description: AMS TCS3430 Color Light-to-Digital Converter

compatible: "ams,tcs3430"

include: [sensor-device.yaml, i2c-device.yaml]

properties:
  int-gpios:
    type: phandle-array
    required: true
    description: |
      INT pin GPIO identifier, open-drain, active low.
  integration-cycles:
    type: int
    default: 256
    description: |
      Initial ADC integration cycle setting from 1 to 256.
      1 cycle = 2.78ms.
  gain:
    type: int
    default: 0
    description: |
      ALS Gain Control:
      0 - 1x
      1 - 4x
      2 - 16x
      3 - 64x
```

## dts/bindings/stepper/adi/adi,tmc5041.yaml
```yaml
# SPDX-FileCopyrightText: Copyright (c) 2024 Carl Zeiss Meditec AG
# SPDX-License-Identifier: Apache-2.0

description: Analog Devices TMC5041 Stepper Motor Controller

compatible: "adi,tmc5041"

include:
  - name: spi-device.yaml
  - name: adi,trinamic-gconf.yaml
    property-allowlist:
      - poscmp_enable
      - shaft1
      - shaft2
      - test_mode
      - lock_gconf

properties:
  "#address-cells":
    default: 1
    const: 1

  "#size-cells":
    default: 0
    const: 0

  clock-frequency:
    type: int
    required: true
    description: |
      The frequency of the clock signal provided to the TMC5041.
      This is used for real world conversion.

      Hint: µstep velocity v[Hz] µsteps / s v[Hz] = v[5041] * ( fCLK[Hz]/2 / 2^23 )
            where v[5041] is the value written to the TMC5041.

child-binding:
  properties:
    stallguard-threshold:
      type: int
      default: 0
      description: |
        This signed value controls StallGuard2 level for stall  output and sets the
        optimum measurement range for readout. A lower value gives a higher sensitivity.
        Zero is the starting value working with most motors.

        -64 to +63: A higher value makes StallGuard2 less sensitive and requires more torque
        to indicate a stall.

    stallguard-threshold-velocity:
      type: int
      default: 0
      description: |
        Threshold velocity for StallGuard2 to detect a stall event.
        Setting this property to a non-zero value activates stallguard detection in the driver.

    stallguard-activation-delay-ms:
      type: int
      default: 0
      description: |
        Stallguard activation delay in ms.
        Stallguard should not be enabled during motor spin-up.
        This delay is also used to check if stepper velocity is greater than
        stallguard-threshold-velocity before enabling stallguard.

  include:
    - name: base.yaml
      property-allowlist:
        - reg
    - name: stepper-controller.yaml
      property-allowlist:
        - micro-step-res
    - name: adi,trinamic-ramp-generator.yaml
      property-allowlist:
        - vstart
        - a1
        - v1
        - amax
        - vmax
        - dmax
        - d1
        - vstop
        - tzerowait
        - vhigh
        - vcoolthrs
        - ihold
        - irun
        - iholddelay
```

## dts/bindings/stepper_motor/gpio-stepper-motor-controller.yaml
```yaml
# SPDX-FileCopyrightText: Copyright (c) 2024 Carl Zeiss Meditec AG
# SPDX-License-Identifier: Apache-2.0

description: GPIO STEPPER MOTOR CONTROLLER

compatible: "gpio-stepper-motor-controller"

include: [stepper-motor-controller.yaml]

properties:
  gpios:
    type: phandle-array
    required: true
    description: |
      The gpio pin  on which the in1 is to be connected
```

## dts/bindings/stepper_motor/motor-controller.yaml
```yaml
# SPDX-FileCopyrightText: Copyright (c) 2024 Carl Zeiss Meditec AG
# SPDX-License-Identifier: Apache-2.0


description: Motor Controller

include: base.yaml

properties:
  "#address-cells":
    const: 1
    default: 1
  "#size-cells":
    const: 0
    default: 0

child-binding:
  description: Motor
  properties:
    reg:
      type: int
      description: motor index

    gear-ratio:
      type: string
      default: "1.0"
      description: |
        Gear ratio from stepper motor to end transmission, This value can be in float and hence
        the property type string
```

## dts/bindings/stepper_motor/stepper-motor-controller.yaml
```yaml
# SPDX-FileCopyrightText: Copyright (c) 2024 Carl Zeiss Meditec AG
# SPDX-License-Identifier: Apache-2.0

description: Stepper Motor Controller

include: motor-controller.yaml

child-binding:
  description: Stepper Motor
  properties:
    micro-step-res:
      type: int
      enum:
        - 1
        - 2
        - 4
        - 8
        - 16
        - 32
        - 64
        - 128
        - 256
      description: |
        Enter the microstep resolution from one of the enum values

    steps-per-revolution:
      type: int
      description: |
        Full steps per revolution, a default value of 200 signifies that 1 step rotates the shaft
        by 1.8°, which is the case in lot of stepper motors
```

## samples/subsys/shell/shell_module/boards/nucleo_g071rb.conf
```kconfig
# SPDX-FileCopyrightText: Copyright (c) 2023 Carl Zeiss Meditec AG
# SPDX-License-Identifier: Apache-2.0


CONFIG_GPIO=y
CONFIG_LED=y

CONFIG_LED_SHELL=y
CONFIG_GPIO_SHELL=y
CONFIG_STEPPER_MOTOR=y
CONFIG_STEPPER_MOTOR_SHELL=y
CONFIG_GPIO_STEPPER_MOTOR_CONTROLLER=y

CONFIG_EXCEPTION_STACK_TRACE=y
CONFIG_CBPRINTF_FP_SUPPORT=y
CONFIG_DEBUG_INFO=y
# CONFIG_NO_OPTIMIZATIONS=y
CONFIG_COMPILER_OPT="-g3"
```

## samples/subsys/testsuite/robotframework/shell/testcase.yaml
```yaml
#
# SPDX-FileCopyrightText: Copyright (c) 2024 Carl Zeiss Meditec AG
# SPDX-License-Identifier: Apache-2.0
#

tests:
  sample.robot.shell:
    filter: CONFIG_SERIAL and dt_chosen_enabled("zephyr,shell-uart")
    min_ram: 40
    harness: robotframework
    extra_configs:
      - arch:posix:CONFIG_NATIVE_UART_0_ON_STDINOUT=y
    integration_platforms:
      - native_posix
    tags:
      - test_framework
      - robot
      - shell
```
