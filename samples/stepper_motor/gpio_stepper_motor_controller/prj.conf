## prj.conf
```kconfig
# SPDX-FileCopyrightText: Copyright (c) 2023 Carl Zeiss Meditec AG
# SPDX-License-Identifier: Apache-2.0


CONFIG_LOG=y
CONFIG_GPIO=y
CONFIG_LED=y
CONFIG_STEPPER_MOTOR=y
CONFIG_GPIO_STEPPER_MOTOR_CONTROLLER=y

CONFIG_CBPRINTF_FP_SUPPORT=y
CONFIG_EXCEPTION_STACK_TRACE=y
CONFIG_DEBUG_INFO=y
# CONFIG_NO_OPTIMIZATIONS=y
CONFIG_COMPILER_OPT="-g3"
```

## boards/nucleo_g071rb.overlay
```dts
/ {
	uln2003_1 {
		compatible = "gpio-stepper-motor-controller";
		gpios = <&gpioa 9 GPIO_ACTIVE_HIGH>,
				<&gpioc 7 GPIO_ACTIVE_HIGH>,
				<&gpiob 0 GPIO_ACTIVE_HIGH>,
				<&gpioa 7 GPIO_ACTIVE_HIGH>;
		motor: motor {
			gear-ratio = "64";
			steps-per-revolution = <32>;
		};
	};
};
```

## src/main.c
```c
/*
 * SPDX-FileCopyrightText: Copyright (c) 2024 Carl Zeiss Meditec AG
 * SPDX-License-Identifier: Apache-2.0
 */

#include "zephyr/drivers/stepper_motor.h"

const struct stepper_motor motor = STEPPER_MOTOR_DT_GET(motor);

int main(void)
{
	for (;;) {
		struct stepper_motor_position_info position_info = {
			.type = MOTOR_POSITION_TARGET,
			.position = 2480,
		};
		stepper_motor_set_position(&motor, &position_info);

		position_info.position = -2480;

		stepper_motor_set_position(&motor, &position_info);
	}

	return 0;
}
```
